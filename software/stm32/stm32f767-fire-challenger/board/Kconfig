## software/stm32/stm32f767-fire-challenger/board/Kconfig
```kconfig
menu "Hardware Drivers Config"

config SOC_STM32F767IG
    bool
    select SOC_SERIES_STM32F7
    default y

menu "Onboard Peripheral Drivers"

    config BSP_USING_USB_TO_USART
        bool "Enable USB TO USART (uart1)"
        select BSP_USING_UART
        select BSP_USING_UART1
        default y

    config BSP_USING_RS232
        bool "Enable RS232 (uart2 pin conflict with Ethernet)"
        select BSP_USING_UART
        select BSP_USING_UART2
        default n

    config BSP_USING_SDRAM
        bool "Enable SDRAM"
        select BSP_USING_FMC
        default n

    config BSP_USING_QSPI_FLASH
        bool "Enable QSPI FLASH (W25Q128 qspi1)"
        select BSP_USING_QSPI
        select RT_USING_SFUD
        select RT_SFUD_USING_QSPI
        default n

    config BSP_USING_LCD
        bool "Enable LCD"
        select BSP_USING_LTDC
        select BSP_USING_SDRAM
        default n

    config BSP_USING_MPU6050
        bool "Enable MPU6050 (i2c1)"
        select BSP_USING_I2C1
        #select PKG_USING_MPU6XXX
        default n

    config BSP_USING_POT
        bool "Enable potentiometer"
        select BSP_USING_ADC
        select BSP_USING_ADC1
        default n
    
    config BSP_USING_SDCARD
        bool "Enable SDCARD (sdio)"
        select BSP_USING_SDIO
        select RT_USING_DFS
        select RT_USING_DFS_ELMFAT
        select RT_USING_PIN
        default n

endmenu

menu "On-chip Peripheral Drivers"

    config BSP_USING_GPIO
        bool "Enable GPIO"
        select RT_USING_PIN
        default y

    menuconfig BSP_USING_UART
        bool "Enable UART"
        default y
        select RT_USING_SERIAL
        if BSP_USING_UART
            config BSP_USING_UART1
                bool "Enable UART1"
                default y

            config BSP_UART1_RX_USING_DMA
                bool "Enable UART1 RX DMA"
                depends on BSP_USING_UART1 && RT_SERIAL_USING_DMA
                default n

            config BSP_USING_UART2
                bool "Enable UART2"
                default n

            config BSP_UART2_RX_USING_DMA
                bool "Enable UART2 RX DMA"
                depends on BSP_USING_UART2 && RT_SERIAL_USING_DMA
                default n

            config BSP_USING_UART3
                bool "Enable UART3"
                default n

            config BSP_UART3_RX_USING_DMA
                bool "Enable UART3 RX DMA"
                depends on BSP_USING_UART3 && RT_SERIAL_USING_DMA
                default n
        endif

    config BSP_USING_ON_CHIP_FLASH
        bool "Enable on-chip FLASH"
        default n
        
menuconfig BSP_USING_SPI
        bool "Enable SPI BUS"
        default n
        select RT_USING_SPI
        if BSP_USING_SPI
            config BSP_USING_SPI1
                bool "Enable SPI1 BUS"
                default n

            config BSP_SPI1_TX_USING_DMA
                bool "Enable SPI1 TX DMA"
                depends on BSP_USING_SPI1
                default n
                
            config BSP_SPI1_RX_USING_DMA
                bool "Enable SPI1 RX DMA"
                depends on BSP_USING_SPI1
                select BSP_SPI1_TX_USING_DMA
                default n

            config BSP_USING_SPI2
                bool "Enable SPI2 BUS"
                default n  
                
            config BSP_SPI2_TX_USING_DMA
                bool "Enable SPI2 TX DMA"
                depends on BSP_USING_SPI2
                default n
                
            config BSP_SPI2_RX_USING_DMA
                bool "Enable SPI2 RX DMA"
                depends on BSP_USING_SPI2
                select BSP_SPI2_TX_USING_DMA
                default n

            config BSP_USING_SPI5
                bool "Enable SPI5 BUS"
                default n  
                
            config BSP_SPI5_TX_USING_DMA
                bool "Enable SPI5 TX DMA"
                depends on BSP_USING_SPI5
                default n
                
            config BSP_SPI5_RX_USING_DMA
                bool "Enable SPI5 RX DMA"
                depends on BSP_USING_SPI5
                select BSP_SPI5_TX_USING_DMA
                default n
        endif

    config BSP_USING_QSPI
        bool "Enable QSPI BUS"
        select RT_USING_QSPI
        select RT_USING_SPI
        default n

    menuconfig BSP_USING_PWM
        bool "Enable pwm"
        default n
        select RT_USING_PWM
        if BSP_USING_PWM
        menuconfig BSP_USING_PWM2
            bool "Enable timer2 output pwm"
            default n
            if BSP_USING_PWM2
                config BSP_USING_PWM2_CH1
                    bool "Enable PWM3 channel1"
                    default n

                config BSP_USING_PWM2_CH2
                    bool "Enable PWM3 channel2"
                    default n

                config BSP_USING_PWM2_CH3
                    bool "Enable PWM3 channel3"
                    default n
            endif
        menuconfig BSP_USING_PWM3
            bool "Enable timer3 output pwm"
            default n
            if BSP_USING_PWM3
                config BSP_USING_PWM3_CH1
                    bool "Enable PWM3 channel1"
                    default n

                config BSP_USING_PWM3_CH2
                    bool "Enable PWM3 channel2"
                    default n

                config BSP_USING_PWM3_CH3
                    bool "Enable PWM3 channel3"
                    default n
            endif
            
        menuconfig BSP_USING_PWM5
            bool "Enable timer5 output pwm"
            default n
            if BSP_USING_PWM5
                config BSP_USING_PWM5_CH1
                    bool "Enable PWM5 channel1"
                    default n

                config BSP_USING_PWM5_CH2
                    bool "Enable PWM5 channel2"
                    default n

                config BSP_USING_PWM5_CH3
                    bool "Enable PWM5 channel3"
                    default n
            endif
        endif
        
    menuconfig BSP_USING_ADC
        bool "Enable ADC"
        default n
        select RT_USING_ADC
        if BSP_USING_ADC
            config BSP_USING_ADC1
                bool "Enable ADC1"
                default n
        endif

    menuconfig BSP_USING_I2C1
        bool "Enable I2C1 BUS (software simulation)"
        default n
        select RT_USING_I2C
        select RT_USING_I2C_BITOPS
        select RT_USING_PIN
        if BSP_USING_I2C1
            comment "Notice: PD12 --> 60; PD13 --> 61" 
            config BSP_I2C1_SCL_PIN
                int "I2C1 scl pin number"
                range 1 176
                default 60
            config BSP_I2C1_SDA_PIN
                int "I2C1 sda pin number"
                range 1 176
                default 61
        endif

    menuconfig BSP_USING_I2C2
        bool "Enable I2C2 BUS (software simulation)"
        default n
        select RT_USING_I2C
        select RT_USING_I2C_BITOPS
        select RT_USING_PIN
        if BSP_USING_I2C2
            comment "Notice: PH4 --> 116; PH5 --> 117" 
            config BSP_I2C2_SCL_PIN
                int "I2C2 scl pin number"
                range 1 176
                default 116
            config BSP_I2C2_SDA_PIN
                int "I2C2 sda pin number"
                range 1 176
                default 117
        endif
    
    menuconfig BSP_USING_I2C3
        bool "Enable I2C3 BUS (software simulation)"
        default n
        select RT_USING_I2C
        select RT_USING_I2C_BITOPS
        select RT_USING_PIN
        if BSP_USING_I2C3
            comment "Notice: PE2 --> 66; PE3 --> 67" 
            config BSP_I2C3_SCL_PIN
                int "I2C3 scl pin number"
                range 1 176
                default 66
            config BSP_I2C3_SDA_PIN
                int "I2C3 sda pin number"
                range 1 176
                default 67
        endif

    menuconfig BSP_USING_I2C4
        bool "Enable I2C4 BUS (software simulation)"
        default n
        select RT_USING_I2C
        select RT_USING_I2C_BITOPS
        select RT_USING_PIN
        if BSP_USING_I2C4
            comment "Notice: PH4 --> 116; PH5 --> 117" 
            config BSP_I2C4_SCL_PIN
                int "I2C4 scl pin number"
                range 1 176
                default 116
            config BSP_I2C4_SDA_PIN
                int "I2C4 sda pin number"
                range 1 176
                default 117
        endif

    menuconfig BSP_USING_ONCHIP_RTC
        bool "Enable RTC"
        select RT_USING_RTC
        select RT_USING_LIBC
        default n
        if BSP_USING_ONCHIP_RTC
            choice
                prompt "Select clock source"
                default BSP_RTC_USING_LSE

                config BSP_RTC_USING_LSE
                    bool "RTC USING LSE"

                config BSP_RTC_USING_LSI
                    bool "RTC USING LSI"
            endchoice
        endif

    config BSP_USING_WDT
        bool "Enable Watchdog Timer"
        select RT_USING_WDT
        default n

    config BSP_USING_SDIO
        bool "Enable SDIO"
        select RT_USING_SDIO
        select RT_USING_DFS
        default n
    
    config BSP_USING_FMC
        bool
        default n

    config BSP_USING_LTDC
        bool
        default n
    
    config BSP_USING_TOUCH
        bool "Enable TOUCH"
        select BSP_USING_I2C4
        default n
        if BSP_USING_TOUCH
            comment "Notice: PD11 --> 59, PB7 --> 23" 
            config BSP_TOUCH_RES_PIN
                int "Touch interrupt pin"
                range 1 176
                default 59
            config BSP_TOUCH_INT_PIN
                int "Touch interrupt pin"
                range 1 176
                default 23
            config BSP_I2C_NAME
                string "I2C Bus Name"
                default "i2c4"
        endif

endmenu

menu "Board extended module Drivers"

    config BSP_USING_SERVO
        bool "Enable Micro Servo"
        select BSP_USING_PWM
        select BSP_USING_PWM3
        select BSP_USING_PWM3_CH2
        default n

    config BSP_USING_EXRTMPU
        bool "Enable external MPU"
        select BSP_USING_I2C2
        select PKG_USING_MOTIONDRIVER2RTT
        select MotionDriver2RTT_USING_EXAMPLE

    menuconfig BSP_USING_PCA9685
        bool "Enable PCA9685"
        select BSP_USING_I2C3
        if BSP_USING_PCA9685
            config PKG_USING_PCA9685
                bool ""
            config PKG_USING_PCA9685_SAMPLE
                bool ""
        endif

endmenu

endmenu
```
